## arch/arm64/configs/union_defconfig
```kconfig
CONFIG_CROSS_COMPILE="aarch64-linux-gnu-"
CONFIG_SYSVIPC=y
CONFIG_POSIX_MQUEUE=y
CONFIG_AUDIT=y
CONFIG_NO_HZ=y
CONFIG_HIGH_RES_TIMERS=y
CONFIG_BSD_PROCESS_ACCT=y
CONFIG_NAMESPACES=y
CONFIG_BLK_DEV_INITRD=y
# CONFIG_RD_BZIP2 is not set
# CONFIG_RD_LZMA is not set
# CONFIG_RD_XZ is not set
CONFIG_EMBEDDED=y
CONFIG_SLAB=y
CONFIG_PROFILING=y
CONFIG_MODULES=y
CONFIG_MODULE_FORCE_LOAD=y
CONFIG_MODULE_UNLOAD=y
CONFIG_MODULE_FORCE_UNLOAD=y
CONFIG_MODVERSIONS=y
CONFIG_MODULE_SRCVERSION_ALL=y
# CONFIG_BLK_DEV_BSG is not set
CONFIG_PARTITION_ADVANCED=y
CONFIG_CMDLINE_PARTITION=y
CONFIG_ARCH_SIGMA_TRIX_OF=y
CONFIG_HOTPLUG_CPU=y
CONFIG_CMDLINE="earlycon=uart8250,mmio32,0xfb005100 mem=188M"
CONFIG_COMPAT=y
# CONFIG_SUSPEND is not set
CONFIG_CPU_FREQ=y
CONFIG_CPU_FREQ_GOV_POWERSAVE=y
CONFIG_CPU_FREQ_GOV_USERSPACE=y
CONFIG_CPU_FREQ_GOV_ONDEMAND=y
CONFIG_NET=y
CONFIG_PACKET=y
CONFIG_UNIX=y
CONFIG_UNIX_DIAG=y
CONFIG_XFRM_USER=y
CONFIG_NET_KEY=y
CONFIG_INET=y
CONFIG_IP_MULTICAST=y
CONFIG_IP_ADVANCED_ROUTER=y
CONFIG_IP_MULTIPLE_TABLES=y
CONFIG_IP_PNP=y
CONFIG_IP_PNP_DHCP=y
CONFIG_IP_PNP_BOOTP=y
CONFIG_IP_PNP_RARP=y
CONFIG_INET_AH=y
CONFIG_INET_ESP=y
# CONFIG_INET_LRO is not set
CONFIG_INET_UDP_DIAG=y
CONFIG_IPV6=y
CONFIG_IPV6_ROUTER_PREF=y
CONFIG_IPV6_OPTIMISTIC_DAD=y
CONFIG_INET6_AH=y
CONFIG_INET6_ESP=y
CONFIG_INET6_IPCOMP=y
CONFIG_IPV6_MIP6=y
CONFIG_IPV6_MULTIPLE_TABLES=y
CONFIG_NETFILTER=y
CONFIG_NF_CONNTRACK=y
CONFIG_NF_CONNTRACK_EVENTS=y
CONFIG_NF_CT_PROTO_DCCP=y
CONFIG_NF_CT_PROTO_SCTP=y
CONFIG_NF_CT_PROTO_UDPLITE=y
CONFIG_NF_CONNTRACK_AMANDA=y
CONFIG_NF_CONNTRACK_FTP=y
CONFIG_NF_CONNTRACK_H323=y
CONFIG_NF_CONNTRACK_IRC=y
CONFIG_NF_CONNTRACK_NETBIOS_NS=y
CONFIG_NF_CONNTRACK_PPTP=y
CONFIG_NF_CONNTRACK_SANE=y
CONFIG_NF_CONNTRACK_TFTP=y
CONFIG_NF_CT_NETLINK=y
CONFIG_NETFILTER_XT_TARGET_CLASSIFY=y
CONFIG_NETFILTER_XT_TARGET_CONNMARK=y
CONFIG_NETFILTER_XT_TARGET_MARK=y
CONFIG_NETFILTER_XT_TARGET_NFLOG=y
CONFIG_NETFILTER_XT_TARGET_NFQUEUE=y
CONFIG_NETFILTER_XT_TARGET_TPROXY=y
CONFIG_NETFILTER_XT_TARGET_TRACE=y
CONFIG_NETFILTER_XT_MATCH_COMMENT=y
CONFIG_NETFILTER_XT_MATCH_CONNLIMIT=y
CONFIG_NETFILTER_XT_MATCH_CONNMARK=y
CONFIG_NETFILTER_XT_MATCH_CONNTRACK=y
CONFIG_NETFILTER_XT_MATCH_HASHLIMIT=y
CONFIG_NETFILTER_XT_MATCH_HELPER=y
CONFIG_NETFILTER_XT_MATCH_IPRANGE=y
CONFIG_NETFILTER_XT_MATCH_LENGTH=y
CONFIG_NETFILTER_XT_MATCH_LIMIT=y
CONFIG_NETFILTER_XT_MATCH_MAC=y
CONFIG_NETFILTER_XT_MATCH_MARK=y
CONFIG_NETFILTER_XT_MATCH_POLICY=y
CONFIG_NETFILTER_XT_MATCH_PKTTYPE=y
CONFIG_NETFILTER_XT_MATCH_QUOTA=y
CONFIG_NETFILTER_XT_MATCH_SOCKET=y
CONFIG_NETFILTER_XT_MATCH_STATE=y
CONFIG_NETFILTER_XT_MATCH_STATISTIC=y
CONFIG_NETFILTER_XT_MATCH_STRING=y
CONFIG_NETFILTER_XT_MATCH_TIME=y
CONFIG_NETFILTER_XT_MATCH_U32=y
CONFIG_NF_CONNTRACK_IPV4=y
CONFIG_IP_NF_IPTABLES=y
CONFIG_IP_NF_MATCH_AH=y
CONFIG_IP_NF_MATCH_ECN=y
CONFIG_IP_NF_MATCH_TTL=y
CONFIG_IP_NF_FILTER=y
CONFIG_IP_NF_TARGET_REJECT=y
CONFIG_IP_NF_MANGLE=y
CONFIG_IP_NF_RAW=y
CONFIG_IP_NF_ARPTABLES=y
CONFIG_IP_NF_ARPFILTER=y
CONFIG_IP_NF_ARP_MANGLE=y
CONFIG_NF_CONNTRACK_IPV6=y
CONFIG_IP6_NF_IPTABLES=y
CONFIG_IP6_NF_FILTER=y
CONFIG_IP6_NF_TARGET_REJECT=y
CONFIG_IP6_NF_MANGLE=y
CONFIG_IP6_NF_RAW=y
CONFIG_NET_SCHED=y
CONFIG_NET_SCH_HTB=y
CONFIG_NET_CLS_U32=y
CONFIG_NET_EMATCH=y
CONFIG_NET_EMATCH_U32=y
CONFIG_NET_CLS_ACT=y
CONFIG_BT=m
CONFIG_BT_RFCOMM=m
CONFIG_BT_BNEP=m
CONFIG_BT_HCIBTUSB=m
# CONFIG_BT_HCIBTUSB_BCM is not set
CONFIG_BT_HCIUART=m
CONFIG_BT_ATH3K=m
CONFIG_CFG80211=m
CONFIG_NL80211_TESTMODE=y
CONFIG_CFG80211_DEVELOPER_WARNINGS=y
CONFIG_CFG80211_REG_DEBUG=y
# CONFIG_CFG80211_DEFAULT_PS is not set
CONFIG_CFG80211_DEBUGFS=y
CONFIG_CFG80211_WEXT=y
CONFIG_LIB80211_DEBUG=y
CONFIG_MAC80211=m
CONFIG_MAC80211_MESH=y
CONFIG_MAC80211_DEBUGFS=y
CONFIG_MAC80211_DEBUG_MENU=y
CONFIG_UEVENT_HELPER_PATH="/sbin/hotplug"
CONFIG_DEVTMPFS=y
CONFIG_DEVTMPFS_MOUNT=y
CONFIG_CONNECTOR=y
CONFIG_MTD=y
CONFIG_BLK_DEV_LOOP=y
CONFIG_BLK_DEV_RAM=y
CONFIG_BLK_DEV_RAM_SIZE=16384
CONFIG_SCSI=y
CONFIG_BLK_DEV_SD=y
CONFIG_CHR_DEV_SG=y
CONFIG_SCSI_LOGGING=y
CONFIG_SCSI_SCAN_ASYNC=y
CONFIG_MD=y
CONFIG_BLK_DEV_DM=y
CONFIG_DM_CRYPT=y
CONFIG_DM_UEVENT=y
CONFIG_NETDEVICES=y
CONFIG_TUN=y
# CONFIG_NET_VENDOR_AMD is not set
# CONFIG_NET_VENDOR_ARC is not set
# CONFIG_NET_CADENCE is not set
# CONFIG_NET_VENDOR_BROADCOM is not set
# CONFIG_NET_VENDOR_INTEL is not set
# CONFIG_NET_VENDOR_MARVELL is not set
# CONFIG_NET_VENDOR_MICREL is not set
# CONFIG_NET_VENDOR_NATSEMI is not set
# CONFIG_NET_VENDOR_QUALCOMM is not set
# CONFIG_NET_VENDOR_ROCKER is not set
# CONFIG_NET_VENDOR_SAMSUNG is not set
# CONFIG_NET_VENDOR_SEEQ is not set
# CONFIG_NET_VENDOR_SMSC is not set
# CONFIG_NET_VENDOR_STMICRO is not set
# CONFIG_NET_VENDOR_VIA is not set
# CONFIG_NET_VENDOR_WIZNET is not set
CONFIG_PPP=y
CONFIG_PPP_BSDCOMP=y
CONFIG_PPP_DEFLATE=y
CONFIG_PPP_MPPE=y
CONFIG_HOSTAP=y
CONFIG_INPUT_JOYDEV=y
CONFIG_INPUT_EVDEV=y
CONFIG_INPUT_JOYSTICK=y
CONFIG_INPUT_TABLET=y
CONFIG_INPUT_TOUCHSCREEN=y
CONFIG_INPUT_MISC=y
CONFIG_INPUT_UINPUT=y
CONFIG_VT_HW_CONSOLE_BINDING=y
# CONFIG_LEGACY_PTYS is not set
CONFIG_SERIAL_8250=y
CONFIG_SERIAL_8250_CONSOLE=y
CONFIG_SERIAL_8250_EXTENDED=y
CONFIG_SERIAL_8250_MANY_PORTS=y
CONFIG_SERIAL_8250_SHARE_IRQ=y
CONFIG_SERIAL_8250_DETECT_IRQ=y
CONFIG_SERIAL_8250_RSA=y
CONFIG_SERIAL_OF_PLATFORM=y
# CONFIG_HW_RANDOM is not set
CONFIG_I2C_CHARDEV=y
CONFIG_I2C_SIGMA_TRIX=y
# CONFIG_HWMON is not set
CONFIG_MEDIA_SUPPORT=y
CONFIG_DRM=y
CONFIG_SOUND=y
CONFIG_SND=y
CONFIG_SND_SEQUENCER=y
CONFIG_SND_MIXER_OSS=y
CONFIG_SND_PCM_OSS=y
CONFIG_SND_SEQUENCER_OSS=y
CONFIG_SND_HRTIMER=y
CONFIG_SND_DUMMY=y
CONFIG_SND_ALOOP=y
CONFIG_SND_USB_AUDIO=y
CONFIG_SND_USB_UA101=y
CONFIG_SND_USB_CAIAQ=y
CONFIG_SND_USB_CAIAQ_INPUT=y
CONFIG_SND_USB_6FIRE=y
CONFIG_HIDRAW=y
CONFIG_UHID=y
CONFIG_HID_A4TECH=y
CONFIG_HID_APPLE=y
CONFIG_HID_BELKIN=y
CONFIG_HID_CHERRY=y
CONFIG_HID_CHICONY=y
CONFIG_HID_CYPRESS=y
CONFIG_HID_EZKEY=y
CONFIG_HID_KENSINGTON=y
CONFIG_HID_LOGITECH=y
CONFIG_HID_LOGITECH_DJ=m
CONFIG_HID_MICROSOFT=y
CONFIG_HID_MONTEREY=y
CONFIG_USB=y
CONFIG_USB_ANNOUNCE_NEW_DEVICES=y
CONFIG_USB_MON=y
CONFIG_USB_EHCI_HCD=y
CONFIG_USB_EHCI_ROOT_HUB_TT=y
CONFIG_USB_STORAGE=y
CONFIG_USB_SERIAL=y
CONFIG_USB_SERIAL_CONSOLE=y
CONFIG_USB_SERIAL_GENERIC=y
CONFIG_USB_SERIAL_FTDI_SIO=y
CONFIG_USB_SERIAL_PL2303=y
CONFIG_TRIX_USB_PHY=y
CONFIG_USB_GADGET=y
CONFIG_MMC=y
CONFIG_MMC_BLOCK_MINORS=28
CONFIG_MMC_SDHCI=y
CONFIG_MMC_SDHCI_PLTFM=y
CONFIG_MMC_SDHCI_OF_TRIX=y
CONFIG_RTC_CLASS=y
CONFIG_STAGING=y
CONFIG_ASHMEM=y
CONFIG_ANDROID_LOW_MEMORY_KILLER=y
CONFIG_SYNC=y
CONFIG_ANDROID=y
CONFIG_ANDROID_BINDER_IPC=y
CONFIG_TEE=y
CONFIG_OPTEE=y
CONFIG_EXT2_FS=y
CONFIG_EXT2_FS_XATTR=y
CONFIG_EXT2_FS_POSIX_ACL=y
CONFIG_EXT2_FS_SECURITY=y
CONFIG_EXT3_FS=y
# CONFIG_EXT3_DEFAULTS_TO_ORDERED is not set
CONFIG_EXT3_FS_POSIX_ACL=y
CONFIG_EXT3_FS_SECURITY=y
CONFIG_EXT4_FS=y
CONFIG_EXT4_FS_SECURITY=y
CONFIG_FANOTIFY=y
CONFIG_QUOTA=y
CONFIG_FUSE_FS=y
CONFIG_CUSE=y
CONFIG_MSDOS_FS=y
CONFIG_VFAT_FS=y
CONFIG_FAT_DEFAULT_IOCHARSET="ascii"
CONFIG_NTFS_FS=y
CONFIG_NTFS_RW=y
CONFIG_TMPFS=y
CONFIG_SQUASHFS=y
CONFIG_NFS_FS=y
CONFIG_NFS_V4=y
CONFIG_ROOT_NFS=y
CONFIG_NLS_DEFAULT="utf8"
CONFIG_NLS_CODEPAGE_437=y
CONFIG_NLS_ASCII=y
CONFIG_NLS_ISO8859_1=y
CONFIG_NLS_UTF8=y
CONFIG_PRINTK_TIME=y
CONFIG_DEBUG_INFO=y
CONFIG_DEBUG_FS=y
CONFIG_DEBUG_MEMORY_INIT=y
CONFIG_TIMER_STATS=y
CONFIG_RCU_CPU_STALL_TIMEOUT=60
# CONFIG_FTRACE is not set
CONFIG_SECURITY=y
CONFIG_SECURITY_NETWORK=y
CONFIG_SECURITY_SELINUX=y
CONFIG_CRYPTO_CCM=y
CONFIG_CRYPTO_GCM=y
CONFIG_CRYPTO_TWOFISH=y
CONFIG_CRYPTO_LZO=y
CONFIG_CRC_CCITT=y
CONFIG_CRC_T10DIF=y
CONFIG_CRC_ITU_T=y
CONFIG_CRC7=y
CONFIG_LIBCRC32C=y
CONFIG_XZ_DEC=y
```

## drivers/clk/trix/Kconfig
```kconfig
config COMMON_CLK_TRIX
	bool "Clock driver for SigmaDesigns DTV SoCs"
	default y
	depends on ARCH_SIGMA_TRIX_OF
	select SYSCON_TRIX
	---help---
	  Support for the Sigma Designs DTV SoC reference, PLL, and device clocks.
```

## drivers/mtd/nand/monza/Kconfig
```kconfig
#
# Ethernet GMAC driver configuration
#
config MTD_NAND_MONZA 
        bool "SigmaDesigns NAND Flash Controller driver" 
        depends on MTD_NAND && (SIGMA_SOC_SX6 || SIGMA_SOC_SX7 || SIGMA_SOC_UXLB)
        help 
         Enables NAND Flash support for SX6/UXLB/SX7.

config MTD_NAND_DMA
        bool "DMA enable"
        depends on MTD_NAND && MTD_NAND_MONZA
	default n

config MTD_MONZA_DEBUG
        bool "Sigma nand debugging"
        depends on MTD_NAND && MTD_NAND_MONZA
	default n
        help
          This is an option for use by developers; most people should
          say N here.  This enables nand driver debugging.

config MTD_HIDTV_PARTS
	bool "Legacy nand partition"
	depends on MTD_NAND && MTD_NAND_MONZA
	default n
	help
	  Legacy NAND partition method by giving "partdef[ partdef]" in cmdline, where partdef 
	  shall be in format: MTD_NAME=name,start,length.
	  For instance, giving "MTD_NAME=boot,0,6M MTD_NAME=kernel,6M,8M MTD_NAME=etc,eM,2M"
	  to  creat three mtd partitions:
	  00000000 - 00600000 : "boot"
	  00600000 - 00e00000 : "kernel"
	  00e00000 - 01000000 : "etc"

	  If unsure say N here.
```

## drivers/mtd/nand/trix/Kconfig
```kconfig
#
# Ethernet GMAC driver configuration
#
config MTD_NAND_TRIX 
        bool "Sdesigns TRIX NAND Flash Controller driver" 
        depends on MTD_NAND && SIGMA_DTV && !SIGMA_DTV_ROM_MMC
        help 
         Enables NAND Flash support for Sigma DTV serial.

config MTD_NAND_DMA_TRIX
        bool "DMA enable"
        depends on MTD_NAND && MTD_NAND_TRIX
	default n

config MTD_DEBUG_TRIX
        bool "Nand debugging"
        depends on MTD_NAND && MTD_NAND_TRIX
	default n
        help
          This is an option for use by developers; most people should
          say N here.  This enables nand driver debugging.

config MTD_PARTS_TRIX_LEGACY
	bool "Legacy nand partition"
	depends on MTD_NAND && MTD_NAND_TRIX
	default n
	help
	  Legacy NAND partition method by giving "partdef[ partdef]" in cmdline, where partdef 
	  shall be in format: MTD_NAME=name,start,length.
	  For instance, giving "MTD_NAME=boot,0,6M MTD_NAME=kernel,6M,8M MTD_NAME=etc,eM,2M"
	  to  creat three mtd partitions:
	  00000000 - 00600000 : "boot"
	  00600000 - 00e00000 : "kernel"
	  00e00000 - 01000000 : "etc"

	  If unsure say N here.
```

## drivers/net/ethernet/sigmadesigns/Kconfig
```kconfig
#
# SigmaDesigns device configuration
#
config NET_VENDOR_SIGMADESIGNS
	bool "Sigma Designs devices"
	default y
	depends on HAS_IOMEM
	---help---
	   Support Sigma Designs' NIC

if NET_VENDOR_SIGMADESIGNS

source "drivers/net/ethernet/sigmadesigns/dwmac/Kconfig"

endif #NET_VENDOR_SIGMADESIGNS
```

## drivers/net/ethernet/sigmadesigns/TRIDENT_GMAC/Kconfig
```kconfig
#
# Ethernet GMAC driver configuration
#

config NET_VENDOR_SIGMADESIGNS
	bool "Sigma Designs SX series SoC"
	default y
	depends on ARCH_SIGMA_TRIX
	help
	  Support Sigma Designs' TRIx SoC

config SIGMA_TRIX_ENET
	tristate "Trix / SX Builtin Gigabit Ethernet support"
	depends on ETHERNET && ARCH_SIGMA_TRIX && NET_VENDOR_SIGMADESIGNS
	select MII
	select CRC32
	help
	 This option adds support for the SMP8xxx integrated Gigabit Ethernet
	 controller.  This driver uses NAPI and generic Linux MII
	 support.

config ETH_SIGMA_TRIX_GMAC_NAPI 
	bool "Ethernet Device uses NAPI"
	depends on SIGMA_TRIX_ENET
	help
	   GMAC will use NAPI

config SIGMA_GMAC_CSUMOFFLOAD
	bool "Checksum Offload"
	depends on SIGMA_TRIX_ENET
	help
	   Checksum Offload

choice
	prompt "MII interface Mode"
	depends on SIGMA_TRIX_ENET
	default GMAC_MODE_RGMII
	help
	 For Selection MII Interface Mode.

config GMAC_MODE_RGMII
	bool "RGMII interface mode enable"
	help
	  Trix Board uses RGMII mode.

config GMAC_MODE_RMII
	bool "RMII interface mode"
	help
	 Trix Board uses RMII mode.

config GMAC_MODE_MII
	bool "MII interface mode enable"
	help
	 Trix Board uses MII mode.

endchoice
```

## drivers/net/ethernet/sigmadesigns/dwmac/Kconfig
```kconfig
#
# Ethernet GMAC driver configuration
#
config GMAC_ETH
	tristate "DTV SX series - designware gmac support"
	depends on ETHERNET && NET_VENDOR_SIGMADESIGNS && SIGMA_DTV
	default y
	select CRC32
	select MII
	select PHYLIB
	help
	 This is the driver for the Ethernet IPs are built around a
	 Synopsys IP Core.
```

## drivers/net/ethernet/sigmadesigns/ftmac/Kconfig
```kconfig
#
# Ethernet GMAC driver configuration
#
config SIGMA_TRIX_FTMAC
	tristate "Trix / UXL Builtin 10/100M Ethernet support"
	depends on ETHERNET && ARCH_SIGMA_TRIX && NET_VENDOR_SIGMADESIGNS
	select CRC32
	select MII
	select PHYLIB
	help
	 This option adds support for the UXL integrated 10/100M Ethernet
	 controller.  This driver uses NAPI and generic Linux MII
	 support.
```

## drivers/soc/trix/Kconfig
```kconfig
#
# SigmaDesigns DTV SOC drivers
#
menu "Sigma DTV SOC specific drivers"

config TRIX_SOC_INFO
	bool "SoC information for Sigma DTV platform"
	depends on ARCH_SIGMA_TRIX_OF
	select SOC_BUS
	default y
	help
	  Select this option to enable displaying soc information

config SYSCON_TRIX
	bool "System Controller Register R/W Based on IO remap"
	depends on ARCH_SIGMA_TRIX_OF
	default y
	help
	  Select this option to enable accessing system control registers
	  via ioremap.

config TRIX_DRV_HELPER
	tristate "system drivers/modules helper"
	depends on ARCH_SIGMA_TRIX_OF
	default y
	help
	  Say y here to enable support for the Sigma DTV driver helper API.
	  The driver provides an interface to access system resource among
	  various kernel drivers/modules.

config TRIX_OTP_FUSE
	bool "OTP(One Time Programable) interface"
	depends on ARCH_SIGMA_TRIX_OF
	default y
	help
	  Select this option to enable accessing OTP fuse bits.

config TRIX_HIDTVMEM
	tristate "/dev/hidtvmem virtual device support"
	depends on ARCH_SIGMA_TRIX_OF
	default y
	help
	  Say Y here if you want to support the /dev/hidtvmem device.
	  The /dev/hidtvmem device is used to access physical memory
	  and MMIO.

source "drivers/soc/trix/firmware/Kconfig"

endmenu
```

## drivers/soc/trix/firmware/Kconfig
```kconfig
menu "DTV Firmware Drivers"

config TRIX_MCU_COMM
	tristate "mcu comm driver"
	depends on ARCH_SIGMA_TRIX_OF
	default y
	help
	  This option enables support for communicating with the MCU firmware

config TRIX_SECURE_FIRMWARE
	tristate "secure firmware support"
	depends on ARCH_SIGMA_TRIX_OF
	default y
	help
	  we are booted with the Trusted Zone, requiring some core operations
	  to be performed by the secure world instead of the kernel

	  This option allows the kernel to invoke the secure world whenever
	  required on devices using SMC calls.

endmenu
```

## fs/exfat/Kconfig
```kconfig
config EXFAT_FS
	tristate "exFAT fs support"
	select NLS
	help
	  This adds support for the exFAT file system.
	  Description on exFAT is available from <http://en.wikipedia.org/wiki/ExFAT#cite_note-reg120808-28>.

config EXFAT_DISCARD
	bool "enable discard support"
	depends on EXFAT_FS
	default y
	help
	  This enables exFAT discard support.
	  If unsure, say Y.

config EXFAT_DELAYED_SYNC
	bool "enable delayed sync"
	depends on EXFAT_FS
	default n
	help
	  This enables exFAT sync support.
	  If unsure, say N.

config EXFAT_KERNEL_DEBUG
	bool "enable kernel debug features via ioctl"
	depends on EXFAT_FS
	default n
	help
	  This enables exFAT kernel debug features.
	  If unsure, say N.

config EXFAT_DEBUG_MSG
	bool "print debug messages"
	depends on EXFAT_FS
	default n
	help
	  This enables exFAT debug message support.
	  If unsure, say N.

config EXFAT_DEFAULT_CODEPAGE
	int "Default codepage for exFAT"
	default 437
	depends on EXFAT_FS
	help
	  This option should be set to the codepage of your exFAT filesystems.
	  If unsure, give 437.

config EXFAT_DEFAULT_IOCHARSET
	string "Default iocharset for exFAT"
	default "utf8"
	depends on EXFAT_FS
	help
	  Set this to the default input/output character set you'd like exFAT to use.
	  If unsure, give "utf8".
```
