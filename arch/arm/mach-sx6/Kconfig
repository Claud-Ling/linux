## arch/arm/mach-sx6/Kconfig
```kconfig
if  ARCH_SIGMA_TRIX

menu "Sigma SX series SoC Specific Features"

choice
	prompt "Select SIGMA DTV SoC type"
	depends on ARCH_SIGMA_TRIX
	help
	  Sigma DTV Soc selection

config SIGMA_SOC_SX6
	bool "SX6"
	select AEABI
	select REGULATOR
	select PM
	select PM_RUNTIME
	select VFP
	select NEON 
	select CPU_V7
	select ARM_GIC
	select HAVE_SMP
	select SMP
	select LOCAL_TIMERS if SMP
	select PL310_ERRATA_588369 if CACHE_L2X0
	select PL310_ERRATA_727915 if CACHE_L2X0
	select ARCH_HAS_OPP
	select PM_OPP if PM
	select ARM_ERRATA_720789 if SMP
	select USB_ARCH_HAS_XHCI
	select SIGMA_OTP_SYS
	help
	  HiDTV-PRO SX6

config SIGMA_SOC_SX7
	bool "SX7"
	select AEABI
	select REGULATOR
	select PM
	select PM_RUNTIME
	select VFP
	select NEON 
	select CPU_V7
	select ARM_GIC
	select HAVE_SMP
	select SMP
	select LOCAL_TIMERS if SMP
	select PL310_ERRATA_588369 if CACHE_L2X0
	select PL310_ERRATA_727915 if CACHE_L2X0
	select ARCH_HAS_OPP
	select PM_OPP if PM
	select ARM_ERRATA_720789 if SMP
	select USB_ARCH_HAS_XHCI
	select SIGMA_OTP_SYS
	help
	  HiDTV-PRO SX7

config SIGMA_SOC_UXLB
	bool "UXLB"
	select AEABI
	select REGULATOR
	select PM
	select PM_RUNTIME
	select VFP
	select NEON 
	select CPU_V7
	select ARM_GIC
	select LOCAL_TIMERS if SMP
	select PL310_ERRATA_588369 if CACHE_L2X0
	select PL310_ERRATA_727915 if CACHE_L2X0
	select ARCH_HAS_OPP
	select PM_OPP if PM
	select ARM_ERRATA_720789 if SMP
	select SIGMA_OTP_EFUSE
	help
	  HiDTV-PRO UXLB

endchoice

config SIGMA_SOC_NAME
	string
	default "TRIX-SX6" if SIGMA_SOC_SX6
	default "TRIX-SX7" if SIGMA_SOC_SX7
	default "TRIX-UXLB" if SIGMA_SOC_UXLB
	default "TRIX"
	help
	  SoC name

config SIGMA_OTP_SYS
	bool
	help
	  Select sigma OTP_SYS that is embedded in Turing

config SIGMA_OTP_EFUSE
	bool
	help
	  Select sigma efuse

choice
	prompt "Select ROM device type"
	depends on SIGMA_SOC_SX6 || SIGMA_SOC_SX7 || SIGMA_SOC_UXLB
	default SIGMA_DTV_ROM_NAND
	help
	  ROM device selection. Keep no change if unsure.

config SIGMA_DTV_ROM_NONE
	bool "NONE"
	help
	  None. Used to reset all ROM related selections.
	  switching between SLC and MLC has to by means of NONE: SLC -> NONE -> MLC or MLC -> NONE -> SLC

config SIGMA_DTV_ROM_NAND
	bool "NAND"
	select MTD
	select MTD_PARTITIONS
	select MTD_CMDLINE_PARTS
	select MTD_CHAR
	select MTD_BLOCK
	select MTD_OOPS
	select MTD_NAND
	select MTD_UBI
	select MTD_UBI_GLUEBI
	select MTD_UBI_DEBUG
	select YAFFS_FS
	select JFFS2_FS
	select UBIFS_FS
	select MTD_NAND_MONZA
	help
	   nand flash on board

config SIGMA_DTV_ROM_MMC
	bool "eMMC"
	select MMC
	select MMC_SDHCI
	select MMC_SDHCI2_SIGMA
	help
	  eMMC

endchoice

config SIGMA_CACHE_L2X0
	bool "Enable L2 Cache "
	default n
	select CACHE_L2X0
	help
	  Turn ON L2 Cache
	  if unsure say Y

config SIGMA_L2X0_PERFORMANCE
	depends on SIGMA_CACHE_L2X0
	bool "L2 Cache performance"
	default n
	help
	  Optimize L2 cache performance. i.e. enable double linefill, .etc.
	  if unsure say N

config ANDROID_PLATFORM
	depends on SIGMA_SOC_SX6 || SIGMA_SOC_SX7 || SIGMA_SOC_UXLB
	bool "Android Support"
	default n
	select SYNC
	select ANDROID
	select ANDROID_BINDER_IPC
	select ANDROID_LOGGER
	select ANDROID_TIMED_OUTPUT
	select ASHMEM
	select ANDROID_LOW_MEMORY_KILLER
	select ANDROID_SWITCH
	select ANDROID_INTF_ALARM_DEV
	help
	  Support Android Platform.
	  Turn ON android support, if unsure say N

config SIGMA_SMC
	depends on SIGMA_SOC_SX6 || SIGMA_SOC_SX7 || SIGMA_SOC_UXLB
	bool "Enable secure monitor call operations"
	default n
	help
	  Enable secure monitor call support, if unsure say N

config SIGMA_SERIAL_IO_MAP
	bool "Map serial io when turn on mmu"
	default y

config SIGMA_VELOCE
	bool "True if run on veloce"
	default y

config SIGMA_DBG
	bool "True if turn on some debug print"
	default y

config SIGMA_PM_CRC
        bool "PM Memory CRC checksum"
	default n
	depends on PM && CRC32
	help
	  Enable the PM code's memory area checksum over sleep. This option
	  will generate CRCs of all blocks of memory, and store them before
	  going to sleep. The blocks are then checked on resume for any
	  errors.

	  Note, this can take several seconds depending on memory size
	  and CPU speed.

config SIGMA_PROC_BOOT_VERSION
	bool "uboot version"
	default n
	help
	  Support display uboot version in /proc/bootversion.
	  if unsure say N

config SIGMA_MIN_CPUFREQ
	int "Minimum cpu frequency(KHz)"
	default 500000
	depends on CPU_FREQ
	help
	  Specify the minimum cpu frequency that is allowed to scale to.
	  if unsure just give 500000

config SIGMA_NR_UMACS
	int "Number of UMACs in use"
	range 1 1 if SIGMA_SOC_UXLB
	range 1 3 if SIGMA_SOC_SX7
	range 1 2
	depends on PM
	default 1 if SIGMA_SOC_UXLB
	default 2 if SIGMA_SOC_SX6
	default 3 if SIGMA_SOC_SX7
	default 1
	help
	  Specify the number of UMACs currently in use

choice
	prompt "UMAC base address options"
	depends on PM && SIGMA_NR_UMACS != 0
	default SIGMA_UMAC_BASES_AUTO
	help
	  UMAC base address options.
	  if unsure just select 'auto'

config SIGMA_UMAC_BASES_AUTO
	bool "auto"
	help
	  Auto select base address for each umacs

config SIGMA_UMAC_BASES_MANUAL
	bool "manual"
	help
	  Manually configure base address for each umacs

endchoice

config CONFIG_REG_BASE_UMAC0
	hex "UMAC0 base"
	depends on SIGMA_UMAC_BASES_MANUAL && (SIGMA_SOC_SX6 || SIGMA_SOC_SX7 || SIGMA_SOC_UXLB)
	default 0xf5021000 if SIGMA_SOC_SX6 || SIGMA_SOC_SX7
	default 0xfb010000 if SIGMA_SOC_UXLB
	help
	  Base address for UMAC0

config CONFIG_REG_BASE_UMAC1
	hex "UMAC1 base"
	depends on SIGMA_UMAC_BASES_MANUAL && (SIGMA_SOC_SX6 || SIGMA_SOC_SX7)
	default 0xf5023000 if SIGMA_SOC_SX6 || SIGMA_SOC_SX7
	help
	  Base address for UMAC1

config CONFIG_REG_BASE_UMAC2
	hex "UMAC2 base"
	depends on SIGMA_UMAC_BASES_MANUAL && SIGMA_SOC_SX7
	default 0xf503b000 if SIGMA_SOC_SX7
	help
	  Base address for UMAC2

endmenu

endif
```

## arch/arm/mach-trix-of/Kconfig
```kconfig
if  ARCH_SIGMA_TRIX_OF

menu "Sigma SX series SoC Specific Features"

choice
	prompt "Select SIGMA DTV SoC type"
	depends on ARCH_SIGMA_TRIX_OF
	help
	  Sigma DTV Soc selection

config SIGMA_SOC_UNION
	bool "UNION"
	help
	  Sigma DTV UNION SoCs support(AARCH32)

config SIGMA_SOC_SX8_OF
	bool "SX8"
	help
	  Sigma DTV SX8 SoCs support

endchoice


config TRIX_CACHE_L2X0
	bool "Enable L2 Cache "
	default n
	select CACHE_L2X0
	help
	  Turn ON L2 Cache
	  if unsure say Y

config ANDROID_PLATFORM
	bool "Android Support"
	default n
	select SYNC
	select ANDROID
	select ANDROID_BINDER_IPC
	select ANDROID_TIMED_OUTPUT
	select ASHMEM
	select ANDROID_LOW_MEMORY_KILLER
	select ANDROID_SWITCH
	select ANDROID_INTF_ALARM_DEV
	help
	  Support Android Platform.
	  Turn ON android support, if unsure say N

config TRIX_UTIL_REGTEST
	bool "regtest utility"
	default n
	help
	  Enable regtest utility support, if unsure say N

menu "release version"

config SIGMA_RELEASE_VERSION
	string "git commit version"
	default "000000"

endmenu #menu "release version"

endmenu

endif
```

## arch/arm/mach-trix/Kconfig
```kconfig
if  ARCH_SIGMA_TRIX

menu "Sigma SX series SoC Specific Features"

choice
	prompt "Select SIGMA DTV SoC type"
	depends on ARCH_SIGMA_TRIX
	help
	  Sigma DTV Soc selection

config SIGMA_SOC_SX6
	bool "SX6"
	select AEABI
	select REGULATOR
	select PM
	select PM_RUNTIME
	select VFP
	select NEON
	select CPU_V7
	select ARM_GIC
	select HAVE_SMP
	select SMP
	select ARCH_HAS_OPP
	select TRIX_OTP_SYS
	select TRIX_HAS_NEW_NAND
	help
	  HiDTV-PRO SX6

config SIGMA_SOC_SX7
	bool "SX7"
	select AEABI
	select REGULATOR
	select PM
	select PM_RUNTIME
	select VFP
	select NEON
	select CPU_V7
	select ARM_GIC
	select HAVE_SMP
	select SMP
	select ARCH_HAS_OPP
	select TRIX_OTP_SYS
	select TRIX_HAS_NEW_NAND
	select TRIX_CPUFREQ_FORWARD if CPU_FREQ && TRIX_SMC
	help
	  HiDTV-PRO SX7

config SIGMA_SOC_UXLB
	bool "UXLB"
	select AEABI
	select REGULATOR
	select PM
	select PM_RUNTIME
	select VFP
	select NEON
	select CPU_V7
	select ARM_GIC
	select ARCH_HAS_OPP
	select TRIX_OTP_EFUSE
	help
	  HiDTV-PRO UXLB

config SIGMA_SOC_SX8
	bool "SX8"
	select AEABI
	select REGULATOR
	select PM
	select PM_RUNTIME
	select VFP
	select NEON
	select CPU_V7
	select ARM_GIC
	select HAVE_SMP
	select SMP
	select ARCH_HAS_OPP
	select TRIX_OTP_SYS
	select TRIX_HAS_NEW_NAND
	help
	  HiDTV-PRO SX8


endchoice

config TRIX_SOC_NAME
	string
	default "TRIX-SX6" if SIGMA_SOC_SX6
	default "TRIX-SX7" if SIGMA_SOC_SX7
	default "TRIX-SX8" if SIGMA_SOC_SX8
	default "TRIX-UXLB" if SIGMA_SOC_UXLB
	default "TRIX"
	help
	  SoC name

config TRIX_OTP_SYS
	bool
	help
	  Select sigma OTP_SYS that is embedded in Turing

config TRIX_OTP_EFUSE
	bool
	help
	  Select sigma legacy efuse

config TRIX_HAS_NEW_NAND
	bool
	help
	  Enable new NAND controller

choice
	prompt "Select ROM device type"
	depends on SIGMA_SOC_SX6 || SIGMA_SOC_SX7 || SIGMA_SOC_UXLB || SIGMA_SOC_SX8
	default SIGMA_DTV_ROM_MMC
	help
	  ROM device selection. Keep no change if unsure.

config SIGMA_DTV_ROM_NONE
	bool "NONE"
	help
	  None. Used to reset all ROM related selections.
	  switching between SLC and MLC has to by means of NONE: SLC -> NONE -> MLC or MLC -> NONE -> SLC

config SIGMA_DTV_ROM_NAND
	bool "NAND"
	select MTD
	select MTD_PARTITIONS
	select MTD_CMDLINE_PARTS
	select MTD_CHAR
	select MTD_BLOCK
	select MTD_BLOCK_ROBBS
	select MTD_OOPS
	select MTD_NAND
	select MTD_UBI
	select MTD_UBI_GLUEBI
	select MTD_UBI_DEBUG
	select YAFFS_FS
	select JFFS2_FS
	select UBIFS_FS
	select MTD_NAND_TRIX
	help
	   nand flash on board

config SIGMA_DTV_ROM_MMC
	bool "eMMC"
	select MMC
	select MMC_SDHCI
	select MMC_SDHCI2_TRIX
	help
	  eMMC

config SIGMA_DTV_ROM_SPI_MMC
	bool "spi + eMMC"
	select MMC
	select MMC_SDHCI
	select MMC_SDHCI2_TRIX
	select MTD
	select MTD_PARTITIONS
	select MTD_CMDLINE_PARTS
	select MTD_CHAR
	select MTD_BLOCK
	select MTD_BLOCK_ROBBS
	select MTD_OOPS
	select MTD_TRIX_SPI_NOR
	help
	  SX8 RevA chip requires MCU boot first than A9 to work around PLL unstable issues.
	  As a result, MCU must boot from SPI flash
endchoice

config TRIX_CACHE_L2X0
	bool "Enable L2 Cache "
	default n
	select CACHE_L2X0
	help
	  Turn ON L2 Cache
	  if unsure say Y

config TRIX_L2X0_PERFORMANCE
	depends on TRIX_CACHE_L2X0
	bool "L2 Cache performance"
	default n
	help
	  Optimize L2 cache performance. i.e. enable double linefill, .etc.
	  if unsure say N

config ANDROID_PLATFORM
	depends on SIGMA_SOC_SX6 || SIGMA_SOC_SX7 || SIGMA_SOC_UXLB || SIGMA_SOC_SX8
	bool "Android Support"
	default n
	select SYNC
	select ANDROID
	select ANDROID_BINDER_IPC
	#select ANDROID_LOGGER # LOGGER driver was removed
	select ANDROID_TIMED_OUTPUT
	select ASHMEM
	select ANDROID_LOW_MEMORY_KILLER
	select ANDROID_SWITCH
	select ANDROID_INTF_ALARM_DEV
	help
	  Support Android Platform.
	  Turn ON android support, if unsure say N

config TRIX_SMC
	depends on SIGMA_SOC_SX6 || SIGMA_SOC_SX7 || SIGMA_SOC_UXLB || SIGMA_SOC_SX8
	bool "Enable secure monitor call operations"
	default n
	help
	  Enable secure monitor call support, if unsure say N

config TRIX_CPUFREQ_FORWARD
	bool "Forward cpufreq transition event"
	depends on TRIX_SMC && CPU_FREQ
	default n
	help
	  Forward cpufreq transition notifiers to secure world

config TRIX_SERIAL_IO_MAP
	bool "Map serial io when turn on mmu"
	default y

config TRIX_VELOCE
	bool "True if run on veloce"
	default n

config TRIX_DBG
	bool "True if turn on some debug print"
	default n

config TRIX_PM_CRC
	bool "PM Memory CRC checksum"
	default n
	depends on PM && CRC32
	help
	  Enable the PM code's memory area checksum over sleep. This option
	  will generate CRCs of all blocks of memory, and store them before
	  going to sleep. The blocks are then checked on resume for any
	  errors.

	  Note, this can take several seconds depending on memory size
	  and CPU speed.

config TRIX_PROC_BOOT_VERSION
	bool "uboot version probe"
	default n
	help
	  Support display uboot version in /proc/bootversion.
	  if unsure say N

config TRIX_MIN_CPUFREQ
	int "Minimum cpu frequency(KHz)"
	default 300000
	depends on CPU_FREQ
	help
	  Specify the minimum cpu frequency that is allowed to scale to.
	  if unsure just give 300000

menu "UMAC options"

config SIGMA_NR_UMACS
	int "Number of UMACs in use"
	range 1 1 if SIGMA_SOC_UXLB
	range 1 3 if SIGMA_SOC_SX7 || SIGMA_SOC_SX8
	range 1 2
	depends on PM
	default 1 if SIGMA_SOC_UXLB
	default 2 if SIGMA_SOC_SX6
	default 3 if SIGMA_SOC_SX7 || SIGMA_SOC_SX8
	default 1
	help
	  Specify the number of UMACs currently in use

choice
	prompt "UMAC base address options"
	depends on PM && SIGMA_NR_UMACS != 0
	default TRIX_UMAC_BASES_AUTO
	help
	  UMAC base address options.
	  if unsure just select 'auto'

config TRIX_UMAC_BASES_AUTO
	bool "auto"
	help
	  Auto select base address for each umacs

config TRIX_UMAC_BASES_MANUAL
	bool "manual"
	help
	  Manually configure base address for each umacs

endchoice

choice
	prompt "UMAC data width options"
	depends on PM && SIGMA_NR_UMACS != 0
	default TRIX_UMAC_WIDTH_AUTO
	help
	  UMAC base address options.
	  if unsure just select 'auto'

config TRIX_UMAC_WIDTH_AUTO
	bool "auto"
	help
	  Auto select data width for each umacs

config TRIX_UMAC_WIDTH_MANUAL
	bool "manual"
	help
	  Manually configure data width for each umacs

endchoice

config REG_BASE_UMAC0
	hex "UMAC0 base"
	depends on TRIX_UMAC_BASES_MANUAL
	default 0xfb010000 if SIGMA_SOC_UXLB
	default 0xf5021000
	help
	  Base address for UMAC0

config REG_BASE_UMAC1
	hex "UMAC1 base"
	depends on TRIX_UMAC_BASES_MANUAL && (SIGMA_NR_UMACS = 2 || SIGMA_NR_UMACS = 3)
	default 0xf5023000
	help
	  Base address for UMAC1

config REG_BASE_UMAC2
	hex "UMAC2 base"
	depends on TRIX_UMAC_BASES_MANUAL && (SIGMA_NR_UMACS = 3)
	default 0xf503b000
	help
	  Base address for UMAC2

config UMAC0_WIDTH
	int "UMAC0 data width"
	depends on TRIX_UMAC_WIDTH_MANUAL
	range 8 32
	default 32
	help
	  UMAC0 data width, number of bits

config UMAC1_WIDTH
	int "UMAC1 data width"
	depends on TRIX_UMAC_WIDTH_MANUAL && (SIGMA_NR_UMACS = 2 || SIGMA_NR_UMACS = 3)
	range 8 32
	default 16 if SIGMA_SOC_SX6
	default 32
	help
	  UMAC1 data width, number of bits

config UMAC2_WIDTH
	int "UMAC2 data width"
	depends on TRIX_UMAC_WIDTH_MANUAL && (SIGMA_NR_UMACS = 3)
	range 8 32
	default 16
	help
	  UMAC2 data width, number of bits

config SIGMA_PM_UMAC_PHY
	bool "UMAC PHY power management option"
	default n
	depends on PM
	help
	  Enable power management option on umac PHYs. This option would
	  reduce umac power consumption in suspend mode. However it does hold
	  additional requirement over schematic design on umac parts.
	  Moreover, enabling this option would break suspend/resume procedure
	  if the schematic design didn't meet the requirement.
	  If unsure say N

endmenu #menu "UMAC options"

config TRIX_DCSN
	bool "DCSN Support"
	default n
	help
	  Enable DCSN driver support, if unsure say N

config TRIX_UTIL_REGTEST
	bool "regtest utility"
	default n
	help
	  Enable regtest utility support, if unsure say N

menu "release version"

config SIGMA_RELEASE_VERSION
	string "git commit version"
	default "000000"

endmenu #menu "release version"

endmenu

endif
```
